## app/boards/shields/ika/Kconfig.defconfig
```kconfig
# Copyright (c) 2021 The ZMK Contributors
# SPDX-License-Identifier: MIT

if SHIELD_IA_LEFT

config ZMK_KEYBOARD_NAME
    default "Ika"

config ZMK_SPLIT_ROLE_CENTRAL
    default y

endif

if SHIELD_IKA_LEFT || SHIELD_IKA_RIGHT

config ZMK_SPLIT
    default y

endif
```

## app/boards/shields/ika/Kconfig.shield
```kconfig
# Copyright (c) 2021 The ZMK Contributors
# SPDX-License-Identifier: MIT

config SHIELD_IKA_LEFT
    def_bool $(shields_list_contains,ika_left)

config SHIELD_IKA_RIGHT
    def_bool $(shields_list_contains,ika_right)
```
